## config/west.yml
```yaml
manifest:
  defaults:
    revision: v0.2 # Pin everything to v0.2

  remotes:
    - name: zmkfirmware
      url-base: https://github.com/zmkfirmware
    - name: urob
      url-base: https://github.com/urob
  projects:
    - name: zmk
      remote: zmkfirmware
      revision: main
      import: app/west.yml

    # ZMK modules
    - name: zmk-tri-state
      remote: urob
  self:
    path: config
```
